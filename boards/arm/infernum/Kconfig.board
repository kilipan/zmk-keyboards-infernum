## boards/arm/infernum/Kconfig.board
```kconfig
# Copyright (c) 2025 The ZMK Contributors
# SPDX-License-Identifier: Apache-2.0

config BOARD_INFERNUM
    bool "Infernum"
    depends on SOC_RP2040
```

## boards/arm/infernum/Kconfig.defconfig
```kconfig
# Copyright (c) 2025 The ZMK Contributors
# SPDX-License-Identifier: MIT

if BOARD_INFERNUM

config ZMK_KEYBOARD_NAME
    default "Infernum"

config RP2_FLASH_W25Q080
    default y

endif # BOARD_INFERNUM
```

## boards/arm/infernum/infernum_defconfig
```kconfig
# Copyright (c) 2025 The ZMK Contributors
# SPDX-License-Identifier: MIT

CONFIG_SOC_SERIES_RP2XXX=y
CONFIG_SOC_RP2040=y
CONFIG_BOARD_INFERNUM=y

CONFIG_SYS_CLOCK_HW_CYCLES_PER_SEC=125000000

# Enable USB CDC ACM logging for debugging
# CONFIG_ZMK_USB_LOGGING=y

# Enable reset by default
CONFIG_RESET=y

# Code partition needed to target the correct flash range
CONFIG_USE_DT_CODE_PARTITION=y

# Output UF2 by default, native bootloader supports it.
CONFIG_BUILD_OUTPUT_UF2=y

# choose funny usb vendor and product ids
CONFIG_USB_DEVICE_VID=0xDEAD
CONFIG_USB_DEVICE_PID=0x0666

# ZMK specific
CONFIG_ZMK_USB=y

# Settings Support
CONFIG_MPU_ALLOW_FLASH_WRITE=y
CONFIG_NVS=y
CONFIG_SETTINGS_NVS=y
CONFIG_FLASH=y
CONFIG_FLASH_PAGE_LAYOUT=y
CONFIG_FLASH_MAP=y

CONFIG_ZMK_KSCAN_MATRIX_POLLING=y 

# Add support for encoders
# CONFIG_EC11=y
# CONFIG_EC11_TRIGGER_GLOBAL_THREAD=y

# RP2040 doesn't have a way to control external power, so we need to explicitly set
CONFIG_ZMK_RGB_UNDERGLOW_EXT_POWER=n
# Enable RGB Ungerglow
CONFIG_ZMK_RGB_UNDERGLOW=y
CONFIG_WS2812_STRIP=y
```

## boards/shields/infernum/Kconfig.defconfig
```kconfig
# SPDX-License-Identifier: MIT

if SHIELD_INFERNUM

config ZMK_KEYBOARD_NAME
    default "infernum"

endif
```
